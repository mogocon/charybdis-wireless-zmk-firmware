## config/boards/arm/charybdis/Kconfig.board
```kconfig
# Charybdis board configuration

# Copyright (c) 2023 The ZMK Contributors
# SPDX-License-Identifier: MIT

config BOARD_CHARYBDIS_LEFT
	bool "Charybdis Left"
	depends on SOC_NRF52840_QIAA

config BOARD_CHARYBDIS_RIGHT
	bool "Charybdis Right"
	depends on SOC_NRF52840_QIAA
```

## config/boards/arm/charybdis/Kconfig.defconfig
```kconfig
# Charybdis board configuration

# Copyright (c) 2023 The ZMK Contributors
# SPDX-License-Identifier: MIT

if BOARD_CHARYBDIS_LEFT

config ZMK_KEYBOARD_NAME
	default "Charybdis"

config ZMK_SPLIT_ROLE_CENTRAL
	default y
	
endif # BOARD_CHARYBDIS_LEFT

if BOARD_CHARYBDIS_RIGHT

config ZMK_KEYBOARD_NAME
	default "Charybdis Right"
	
endif # BOARD_CHARYBDIS_RIGHT

if BOARD_CHARYBDIS_LEFT || BOARD_CHARYBDIS_RIGHT

config BOARD
	default "charybdis"

config ZMK_SPLIT
	default y

config BT_CTLR
	default BT

config ZMK_BLE
	default y

config ZMK_USB
	default y

endif # BOARD_CHARYBDIS_LEFT || BOARD_CHARYBDIS_RIGHT
```

## config/boards/arm/charybdis/charybdis_left_defconfig
```kconfig
# Copyright (c) 2023 The ZMK Contributors
# SPDX-License-Identifier: MIT

CONFIG_SOC_SERIES_NRF52X=y
CONFIG_SOC_NRF52840_QIAA=y
CONFIG_BOARD_CHARYBDIS_LEFT=y

# Enable MPU
CONFIG_ARM_MPU=y

# Enable GPIO
CONFIG_GPIO=y

# Clock configuration
CONFIG_CLOCK_CONTROL_NRF_K32SRC_30PPM=y

# Enable SPI for trackball
CONFIG_SPI=y

# Enable pinctrl
CONFIG_PINCTRL=y

# Enable serial drivers
CONFIG_SERIAL=y
CONFIG_UART_INTERRUPT_DRIVEN=y

# Enable console
CONFIG_CONSOLE=y
CONFIG_UART_CONSOLE=y

# Enable USB
CONFIG_USB=y
CONFIG_USB_DEVICE_STACK=y
CONFIG_USB_DEVICE_MANUFACTURER="ZMK Project"
CONFIG_USB_DEVICE_PRODUCT="Charybdis Keyboard"
CONFIG_USB_DEVICE_VID=0x1D50
CONFIG_USB_DEVICE_PID=0x615E
CONFIG_USB_DEVICE_HID=y
CONFIG_USB_HID_BOOT_PROTOCOL=y
CONFIG_USB_CDC_ACM=y

# Enable IEEE802154 drivers
CONFIG_NET_L2_IEEE802154=y
CONFIG_IEEE802154_NRF5=y

# Enable Bluetooth
CONFIG_BT=y
CONFIG_BT_CTLR=y
CONFIG_BT_L2CAP_TX_MTU=69
CONFIG_BT_PERIPHERAL=y
CONFIG_BT_GATT_DIS=y
CONFIG_BT_GATT_BAS=y
CONFIG_BT_TINYCRYPT_ECC=y
CONFIG_ZMK_BLE=y

# Enable keyboard specific settings
CONFIG_ZMK_KEYBOARD_NAME="Charybdis"
CONFIG_ZMK_USB=y
CONFIG_ZMK_BLE_CLEAR_BONDS_ON_START=n
CONFIG_ZMK_SLEEP=y
CONFIG_ZMK_MOUSE=y
CONFIG_ZMK_TRACKBALL=y
CONFIG_ZMK_PMW3610=y

# Enable split keyboard
CONFIG_ZMK_SPLIT=y
CONFIG_ZMK_SPLIT_BLE=y
CONFIG_ZMK_SPLIT_BLE_CENTRAL_PERIPHERALS=y

# Enable encoder
CONFIG_EC11=y
CONFIG_EC11_TRIGGER_GLOBAL_THREAD=y

# Enable deep sleep support
CONFIG_ZMK_SLEEP=y
CONFIG_ZMK_IDLE_SLEEP_TIMEOUT=900000

# Increase BLE transmit power
CONFIG_BT_CTLR_TX_PWR_PLUS_8=y
```

## config/boards/shields/splinky_v2/Kconfig.defconfig
```kconfig
# Copyright (c) 2022 The ZMK Contributors
# SPDX-License-Identifier: MIT

if SHIELD_SPLINKY_V2_LEFT

config ZMK_KEYBOARD_NAME
	default "Charybdis v2"

config ZMK_SPLIT_ROLE_CENTRAL
	default y

endif

if SHIELD_SPLINKY_V2_LEFT || SHIELD_SPLINKY_V2_RIGHT

config ZMK_SPLIT
	default y

endif
```

## config/boards/shields/splinky_v2/Kconfig.shield
```kconfig
# Copyright (c) 2022 The ZMK Contributors
# SPDX-License-Identifier: MIT

config SHIELD_SPLINKY_V2_LEFT
	def_bool $(shields_list_contains,splinky_v2_left)

config SHIELD_SPLINKY_V2_RIGHT
	def_bool $(shields_list_contains,splinky_v2_right)
```

## config/west.yml
```yaml
manifest:
  remotes:
    - name: zmkfirmware
      url-base: https://github.com/zmkfirmware
    - name: perillamint
      url-base: https://github.com/perillamint
  projects:
    - name: zmk
      remote: perillamint
      revision: charybdis-pmw3610
      import: app/west.yml
  self:
    path: config
```
