/*
 * Copyright (c) 2022 The ZMK Contributors
 *
 * SPDX-License-Identifier: MIT
 */

#include <dt-bindings/zmk/mouse.h>

/ {
    pmw3610_config: pmw3610_config {
        compatible = "zmk,mouse-config";
        status = "okay";

        // Example mouse movement parameters - modify to preference
        time-to-max-speed-ms = <500>;
        acceleration-exponent = <1>;
        
        // Initial scroll configurations, can be modified through behaviors
        scroll-layer = <3>;     // Default layer for scroll mode
        scroll-mode = <0>;      // Initially disabled

        // Configure dpi settings here
        default-dpi = <1000>;   // Default DPI

        // Trackball tap, switch, and cursor behaviors
        tap-ms = <50>;
        switch-layer = <2>;     // Layer for trackball enabled
    };
};